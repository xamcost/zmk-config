## boards/shields/ferris_sweep/Kconfig.shield
```kconfig
config SHIELD_FERRIS_SWEEP_DONGLE
    def_bool $(shields_list_contains,ferris_sweep_dongle)
```

## boards/shields/sweep/Kconfig.defconfig
```kconfig
if SHIELD_SWEEP_DONGLE

# Max 16 characters in keyboard name
config ZMK_KEYBOARD_NAME
    default "Sweep"

config ZMK_SPLIT_ROLE_CENTRAL
    default y

endif

if SHIELD_SWEEP_DONGLE || SHIELD_SWEEP_LEFT || SHIELD_SWEEP_RIGHT

config ZMK_SPLIT
    default y

endif
```
